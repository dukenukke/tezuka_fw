## package/iio_ws/Config.in
```kconfig
config BR2_PACKAGE_IIO_WS
	bool "iio_ws_proxy"
	depends on BR2_TOOLCHAIN_HAS_THREADS
	depends on !BR2_STATIC_LIBS
	select BR2_PACKAGE_LIBIIO
	select BR2_PACKAGE_LIBWEBSOCKETS
	help
	  IIO stream to WebSocket proxy.

comment "iio_ws_proxy needs a toolchain w/ threads, dynamic library"
	depends on !BR2_TOOLCHAIN_HAS_THREADS || BR2_STATIC_LIBS
```

## package/pluto_rx/Config.in
```kconfig
config BR2_PACKAGE_PLUTO_RX
	bool "pluto_rx tools"
	depends on BR2_TOOLCHAIN_HAS_THREADS
	select BR2_PACKAGE_LIBIIO
	select BR2_PACKAGE_CIVETWEBWS
	select BR2_PACKAGE_CIVETWEBWS_LIB
	help
	  Build the Pluto RX sample streaming tools.

	  This installs the plutorx command-line streaming tool. Raw CS8 IQ
	  WebSocket streaming is provided by maia-httpd at /iq.

comment "pluto_rx tools need a toolchain w/ threads"
	depends on !BR2_TOOLCHAIN_HAS_THREADS
```

## package/serial_ws/Config.in
```kconfig
config BR2_PACKAGE_SERIAL_WS
	bool "serial WebSocket bridge"
	depends on BR2_TOOLCHAIN_HAS_THREADS
	select BR2_PACKAGE_CIVETWEBWS
	select BR2_PACKAGE_CIVETWEBWS_LIB
	help
	  Bidirectional binary WebSocket bridge for a serial device.

comment "serial WebSocket bridge needs a toolchain w/ threads"
	depends on !BR2_TOOLCHAIN_HAS_THREADS
```
